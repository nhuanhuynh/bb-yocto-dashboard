## build/conf/bblayers.conf
```bitbake
# POKY_BBLAYERS_CONF_VERSION is increased each time build/conf/bblayers.conf
# changes incompatibly
POKY_BBLAYERS_CONF_VERSION = "2"

BBPATH = "${TOPDIR}"
BBFILES ?= ""

BBLAYERS ?= " \
  /home/allan/working/yocto/poky/meta \
  /home/allan/working/yocto/poky/meta-poky \
  /home/allan/working/yocto/poky/meta-yocto-bsp \
  /home/allan/working/yocto/meta-ti/meta-ti-bsp \
  /home/allan/working/yocto/meta-arm/meta-arm \
  /home/allan/working/yocto/meta-arm/meta-arm-toolchain \
  "
```

## meta-bbb-custom/conf/layer.conf
```bitbake
# We have a conf and classes directory, add to BBPATH
BBPATH .= ":${LAYERDIR}"

# We have recipes-* directories, add to BBFILES
BBFILES += "${LAYERDIR}/recipes-*/*/*.bb \
            ${LAYERDIR}/recipes-*/*/*.bbappend"

BBFILE_COLLECTIONS += "meta-bbb-custom"
BBFILE_PATTERN_meta-bbb-custom = "^${LAYERDIR}/"
BBFILE_PRIORITY_meta-bbb-custom = "6"

LAYERDEPENDS_meta-bbb-custom = "core"
LAYERSERIES_COMPAT_meta-bbb-custom = "kirkstone"
```
